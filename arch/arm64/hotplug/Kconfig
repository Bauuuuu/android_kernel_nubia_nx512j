## arch/arm64/hotplug/Kconfig
```kconfig
config BRICKED_HOTPLUG
	   bool "Enable kernel based mpdecision"
	   depends on MSM_RUN_QUEUE_STATS
	   default n
	   help
		 This enables kernel based multi core control.

config ALUCARD_HOTPLUG
	bool "Enable alucard-hotplug cpu hotplug driver"
	default n
	help
	Generic Alucard-hotplug cpu hotplug driver for ARM SOCs

config INTELLI_PLUG
	    bool "Enable intelli-plug cpu hotplug driver"
	    default y
	    help
	         Generic Intelli-plug cpu hotplug driver for ARM SOCs
```

## drivers/platform/nubia/Kconfig
```kconfig
# Nubia configuration options

config MACH_NUBIA
	bool "Nubia device"
	depends on ARCH_MSM
	help
	  Support for Nubia products

config MACH_NUBIA_MSM8939
	bool "Nubia MSM8939"
	depends on ARCH_MSM8916
	select MACH_NUBIA
	help
	  Support for MSM8939 Nubia variants
menu "Nubia board selection"

config MACH_NX512J
	bool "NX512J board"
	select MACH_NUBIA_MSM8939
	help
	  Support for Nubia NX512J variant

endmenu
```
